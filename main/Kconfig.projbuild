## main/Kconfig.projbuild
```kconfig
menu "QueSera Configuration"

config ESP_WIFI_SSID
    string "WiFi SSID"
    default "whatever"
    help
	SSID (network name) for the example to connect to.

config ESP_WIFI_PASSWORD
    string "WiFi Password"
    default "whatever"
    help
	WiFi password (WPA or WPA2) for the example to use.

config ESP_MAXIMUM_RETRY
    int "WiFi connection maximum retry count"
    default 5
    help
	Set the Maximum retry to avoid station reconnecting to the AP unlimited when the AP is really inexistent.

config HTTP_RECV_BUFFER_SIZE
    int "HTTP client stream buffer size"
    default 512
    help
    Set the buffer size for HTTP client's stream reader

config ICAL_DEFAULT_URL
    string "iCal default URL"
    default ""
    help
    Default string for an iCal file from a Calendar service provider (e.g. Outlook or Google Calendar)

config ICAL_CACHE_PATH
    string "iCal default cache path"
    default "/spiffs/main.ical"
    help
    Default path for an iCal file cache in SPIFFS

endmenu
```
